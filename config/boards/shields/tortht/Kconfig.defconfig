## config/boards/shields/tortht/Kconfig.defconfig
```kconfig
if SHIELD_TORTHT_R

config ZMK_KEYBOARD_NAME
    default "tortht"

config ZMK_SPLIT
    default y

config ZMK_SPLIT_ROLE_CENTRAL
    default y

config ZMK_POINTING
    default y

config PAW3222
    default y

endif

if SHIELD_TORTHT_L

config ZMK_KEYBOARD_NAME
    default "tortht_L"

config ZMK_SPLIT
    default y

config ZMK_POINTING
    default y

config PAW3222
    default y

endif
```

## config/boards/shields/tortht/Kconfig.shield
```kconfig
config SHIELD_TORTHT_R
    def_bool $(shields_list_contains,tortht_R)

config SHIELD_TORTHT_L
    def_bool $(shields_list_contains,tortht_L)
```

## config/west.yml
```yaml
manifest:
  remotes:
    - name: zmkfirmware
      url-base: https://github.com/zmkfirmware
    - name: yasio25119915
      url-base: https://github.com/yasio25119915
  projects:
    - name: zmk
      remote: zmkfirmware
      revision: v0.2.1
      import: app/west.yml
    - name: zmk-driver-paw3222
      remote: yasio25119915
      revision: master
  self:
    path: config
```
